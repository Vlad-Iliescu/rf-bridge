## main/Kconfig.projbuild
```kconfig
menu "RF Bridge"

    config RF_TRANSMITTER_DATA_GPIO
        int "RF TRANSMITTER DATA GPIO number"
        range 0 34
        default 32
        help
            GPIO number (IOxx) to rf transmitter

            Some GPIOs are used for other purposes (flash connections, etc.) and cannot be used to blink.

            GPIOs 35-39 are input-only so cannot be used as outputs.

    config WIFI_SSID
        string "WIFI SSID"
        default "SSID"
        help
            Your router SSID. The Wifi network the device will connect to

    config WIFI_PASS
        string "WIFI_PASS"
        default "pass"
        help
            The Wifi password where the device will connect to

    config MQTT_HOST
        string "MQTT_HOST"
        default "mqtt://127.0.0.1"
        help
            Host to the mqtt broker, must contain "mqtt://"

    config MQTT_TOPIC
        string "MQTT_TOPIC"
        default "lights/switch"
        help
            Host to the mqtt broker, must contain "mqtt://"

    config MQTT_QUEUE_SIZE
        int "MQTT_QUEUE_SIZE"
        default 10
        help
            The max size of the mqtt queue
endmenu
```
